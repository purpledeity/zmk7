## config/west.yml
```yaml
manifest:
  remotes:
    - name: zmkfirmware
      url-base: https://github.com/zmkfirmware
    - name: zmkfirmware2
      url-base: https://github.com/ftc/     # <--- CHANGE REPO
    # Additional modules containing boards/shields/custom code can be listed here as well
    # See https://docs.zephyrproject.org/3.2.0/develop/west/manifest.html#projects

  projects:
    - name: zmk
      remote: zmkfirmware
      revision: main                   # <--- CHANGE REVISION
      import: app/west.yml
    - name: zmk
      remote: zmkfirmware2
      revision: mouse-ftc                   # <--- CHANGE REVISION
      import: app/west.yml
  self:
    path: config
```
